## boards/shields/geta/Kconfig.defconfig
```kconfig
# Copyright (c) 2022 The ZMK Contributors
# SPDX-License-Identifier: MIT

if SHIELD_GETA_DONGLE

config ZMK_KEYBOARD_NAME
    default "Geta"
    
config ZMK_SPLIT_ROLE_CENTRAL
    default y

config ZMK_USB
    default y

endif

if SHIELD_GETA_LEFT || SHIELD_GETA_RIGHT || SHIELD_GETA_DONGLE

config ZMK_SPLIT
    default y

config ZMK_BLE
    default y
endif
```
