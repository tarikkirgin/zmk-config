#include <behaviors.dtsi>
#include <behaviors/unicode.dtsi>
#include <behaviors/num_word.dtsi>
#include <dt-bindings/zmk/keys.h>
#include <dt-bindings/zmk/bt.h>
#include <dt-bindings/zmk/outputs.h>
#include <dt-bindings/zmk/pointing.h>
#include "zmk-helpers/helper.h"

#define KEYS_L LT0 LT1 LT2 LT3 LM0 LM1 LM2 LM3 LM4 LM5 LB0 LB1 LB2 LB3 LB4
#define KEYS_R RT0 RT1 RT2 RT3 RM0 RM1 RM2 RM3 RM4 RM5 RB0 RB1 RB2 RB3 RB4
#define KEYS_THUMB LH1 LH0 RH0 RH1

#define QWERTY         0
#define MAC            1
#define ALTERNATE      2
#define ALTERNATE_MAC  3
#define NAVIGATION     4
#define NAVIGATION_MAC 5
#define SYMBOL         6
#define NUMBER         7
#define FUNCTION       8
#define KEYBOARD       9

#define RHYP RS(RA(RC(RGUI)))

#define DEL_WORD   &kp LC(BSPC)
#define SEL_ALL    &kp LC(A)
#define UNDO       &kp LC(Z)
#define REDO       &kp LC(LS(Z))
#define CUT        &kp LC(X)
#define COPY       &kp LC(C)
#define PASTE      &kp LC(V)

#define DEL_WORD_M &kp LA(BSPC)
#define SEL_ALL_M  &kp LG(A)
#define UNDO_M     &kp LG(Z)
#define REDO_M     &kp LG(LS(Z))
#define CUT_M      &kp LG(X)
#define COPY_M     &kp LG(C)
#define PASTE_M    &kp LG(V)

#define _ &trans
#define GBP UC_CURR_POUND

&uc {
  default-mode = <UC_MODE_WIN_ALT>;
};

&caps_word {
    continue-list = <UNDERSCORE MINUS BSPC DEL N0 N1 N2 N3 N4 N5 N6 N7 N8 N9 LGUI LALT LCTRL LSHFT LEFT DOWN UP RIGHT>;
};

&num_word {
    continue-list = <DOLLAR GBP DOT COMMA PLUS MINUS STAR FSLH EQUAL BSPC DEL LEFT DOWN UP RIGHT>;
    ignore-modifiers;
};

ZMK_HOLD_TAP(hl,
    flavor = "balanced";
    tapping-term-ms = <280>;
    quick-tap-ms = <175>;
    require-prior-idle-ms = <150>;
    bindings = <&kp>, <&kp>;
    hold-trigger-key-positions = <KEYS_R KEYS_THUMB>;
    hold-trigger-on-release;
)

ZMK_HOLD_TAP(hr,
    flavor = "balanced";
    tapping-term-ms = <280>;
    quick-tap-ms = <175>;
    require-prior-idle-ms = <150>;
    bindings = <&kp>, <&kp>;
    hold-trigger-key-positions = <KEYS_L KEYS_THUMB>;
    hold-trigger-on-release;
)

ZMK_MOD_MORPH(dot_excl, bindings = <&kp DOT>, <&kp EXCL>; mods = <(MOD_LSFT|MOD_RSFT)>;)
ZMK_MOD_MORPH(comma_ques, bindings = <&kp COMMA>, <&kp QUESTION>; mods = <(MOD_LSFT|MOD_RSFT)>;)
ZMK_MOD_MORPH(slash_both, bindings = <&kp SLASH>, <&kp BACKSLASH>; mods = <(MOD_LSFT|MOD_RSFT)>;)

/ {
    behaviors {
        tog_on: toggle_layer_on_only {
            compatible = "zmk,behavior-toggle-layer";
            #binding-cells = <1>;
            toggle-mode = "on";
        };

        tog_off: toggle_layer_off_only {
            compatible = "zmk,behavior-toggle-layer";
            #binding-cells = <1>;
            toggle-mode = "off";
        };
    };
};

ZMK_MACRO(mac_on,
    bindings = <
        &tog_on MAC
        &uc UC_SET_MACOS
    >;
)

ZMK_MACRO(mac_off,
    bindings = <
        &tog_off MAC
        &uc UC_SET_WIN_ALT
    >;
)

ZMK_CONDITIONAL_LAYER(mac_navigation, MAC NAVIGATION, NAVIGATION_MAC)
ZMK_CONDITIONAL_LAYER(mac_canary, MAC ALTERNATE, ALTERNATE_MAC)

ZMK_CONDITIONAL_LAYER(kbd_layer, SYMBOL FUNCTION, KEYBOARD)

ZMK_TRI_STATE(alt_tab, bindings = <&kt LALT>, <&kp TAB>, <&kt LALT>; ignored-key-positions = <LT2 LT1 RM0 RM1 RM2 RM3>;)
ZMK_TRI_STATE(alt_tab_m, bindings = <&kt LCMD>, <&kp TAB>, <&kt LCMD>; ignored-key-positions = <LT2 LT1 RM0 RM1 RM2 RM3>;)

ZMK_BASE_LAYER(qwerty,
    //                      ╭──────────┬──────────┬──────────┬──────────╮   ╭──────────┬──────────┬──────────┬──────────╮
    //                      │  W       │  E       │  R       │  T       │   │  Y       │  U       │  I       │  O       │
                               &kp W      &kp E      &kp R      &kp T          &kp Y      &kp U      &kp I      &kp O     
    //╭──────────┬──────────┼──────────┼──────────┼──────────┼──────────┤   ├──────────┼──────────┼──────────┼──────────┼──────────┬──────────╮
    //│  Q       │  A       │  S       │  D       │  F       │  G       │   │  H       │  J       │  K       │  L       │  ; :     │  P       │
      &hl RHYP Q &hl LGUI A &hl LALT S &hl LCTRL D &hl LSHFT F  &kp G         &kp H &hr RSHFT J &hr RCTRL K &hr RALT L &hr RGUI SEMI &hr RHYP P
    //╰──────────┼──────────┼──────────┼──────────┼──────────┼──────────┤   ├──────────┼──────────┼──────────┼──────────┼──────────┼──────────╯
    //           │  Z       │  X       │  C       │  V       │  B       │   │  N       │  M       │ , ?      │ . !      │  / \     │
                    &kp Z      &kp X      &kp C      &kp V      &kp B          &kp N      &kp M    &comma_ques &dot_excl &slash_both
    //           ╰──────────┴──────────┴──────────┼──────────┼──────────┤   ├──────────┼──────────┼──────────┴──────────┴──────────╯
    //                                            │  SPACE   │  ENTER   │   │  ESCAPE  │BACKSPACE │
                                            &lt NAVIGATION SPC &lt SYMBOL   ENTER &lt FUNCTION ESC &lt NUMBER BSPC
    //                                            ╰──────────┴──────────╯   ╰──────────┴──────────╯
)

ZMK_BASE_LAYER(qwerty_mac,
    _ _ _ _  _ _ _ _
    _ &hl LCTRL A _  &hl LGUI D _ _  _ _ &hr RGUI K _ &hr RCTRL SEMI _
    _ _ _ _ _  _ _ _ _ _
    _ _  _ _
)

ZMK_BASE_LAYER(alt,
    //                      ╭──────────┬──────────┬──────────┬──────────╮   ╭──────────┬──────────┬──────────┬──────────╮
    //                      │  L       │  Y       │  P       │  B       │   │  Z       │  F       │  O       │  U       │
                               &kp L      &kp Y      &kp P      &kp B          &kp Z      &kp F      &kp O      &kp U     
    //╭──────────┬──────────┼──────────┼──────────┼──────────┼──────────┤   ├──────────┼──────────┼──────────┼──────────┼──────────┬──────────╮
    //│  W       │  C       │  R       │  S       │  T       │  G       │   │  M       │  N       │  E       │  I       │  A       │  ' "     │
      &hl RHYP W &hl LGUI C &hl LALT R &hl LCTRL S &hl LSHFT T  &kp G          &kp M &hr RSHFT N &hr RCTRL E &hr RALT I &hr RGUI A &hr RHYP SQT
    //╰──────────┼──────────┼──────────┼──────────┼──────────┼──────────┤   ├──────────┼──────────┼──────────┼──────────┼──────────┼──────────╯
    //           │  Q       │  J       │  V       │  D       │  K       │   │  X       │  H       │  / \     │ , ?      │ . !      │
                    &kp Q      &kp J      &kp V      &kp D      &kp K          &kp X      &kp H   &slash_both &comma_ques &dot_excl 
    //           ╰──────────┴──────────┴──────────┼──────────┼──────────┤   ├──────────┼──────────┼──────────┴──────────┴──────────╯
    //                                            │          │          │   │          │          │
                                                     _          _              _          _
    //                                            ╰──────────┴──────────╯   ╰──────────┴──────────╯
)

ZMK_BASE_LAYER(alt_mac,
    _ _ _ _  _ _ _ _
    _ &hl LCTRL C _  &hl LGUI S _ _  _ _ &hr RGUI E _ &hr RCTRL A _
    _ _ _ _ _  _ _ _ _ _
    _ _  _ _
)

ZMK_BASE_LAYER(navigation,
    //                      ╭──────────┬──────────┬──────────┬──────────╮   ╭──────────┬──────────┬──────────┬──────────╮
    //                      │ C+A+DEL  │ PREV WIN │ NEXT WIN │  REDO    │   │  HOME    │ PG DOWN  │  PG UP   │  END     │
                        &kp LC(LA(DEL)) &kp LS(TAB) &alt_tab    REDO          &kp HOME   &kp PG_DN  &kp PG_UP  &kp END      
    //╭──────────┬──────────┼──────────┼──────────┼──────────┼──────────┤   ├──────────┼──────────┼──────────┼──────────┼──────────┬──────────╮
    //│CAPS WORD │          │          │          │          │  UNDO    │   │  LEFT    │  DOWN    │  UP      │  RIGHT   │  TAB     │SHIFT+TAB │
       &caps_word  &kp LGUI   &kp LALT  &kp LCTRL  &kp LSHFT    UNDO          &kp LEFT   &kp DOWN    &kp UP   &kp RIGHT   &kp TAB   &kp LS(TAB) 
    //╰──────────┼──────────┼──────────┼──────────┼──────────┼──────────┤   ├──────────┼──────────┼──────────┼──────────┼──────────┼──────────╯
    //           │SELECT ALL│  CUT     │  COPY    │  PASTE   │ NUM WORD │   │ PRNTSCRN │  REPEAT  │  DELETE  │  MB4     │  MB5     │
                   SEL_ALL     CUT        COPY       PASTE  &num_word NUMBER &kp PSCRN  &key_repeat  &kp DEL   &mkp MB4   &mkp MB5
    //           ╰──────────┴──────────┴──────────█▀▀▀▀▀▀▀▀▀▀█──────────┤   ├──────────┼──────────┼──────────┴──────────┴──────────╯
    //                                            ▌          ▐          │   │  CANCEL  │ DEL WORD │
                                                     _          _           &kp K_CANCEL DEL_WORD
    //                                            ▙▄▄▄▄▄▄▄▄▄▄▟──────────╯   ╰──────────┴──────────╯
)

ZMK_BASE_LAYER(navigation_mac,
    _ _ &alt_tab_m REDO_M  _ _ _ _
    _ &kp LCTRL &kp LALT &kp LGUI &kp LSHFT UNDO_M  _ _ _ _ _ _
    SEL_ALL_M CUT_M COPY_M PASTE_M _  _ _ _ _ _
    _ _  _ DEL_WORD_M
)

ZMK_BASE_LAYER(symbol,
    //                      ╭──────────┬──────────┬──────────┬──────────╮   ╭──────────┬──────────┬──────────┬──────────╮
    //                      │  ]       │  }       │  )       │  #       │   │  \       │  (       │  {       │  [       │
                              &kp RBKT   &kp RBRC   &kp RPAR   &kp HASH       &kp FSLH   &kp LPAR   &kp LBRC   &kp LBKT 
    //╭──────────┬──────────┼──────────┼──────────┼──────────┼──────────┤   ├──────────┼──────────┼──────────┼──────────┼──────────┬──────────╮
    //│  >       │          │          │          │          │          │   │  &       │  -       │  _       │  '       │  "       │  <       │
         &kp GT     _          _          _          _          _             &kp AMPS   &kp MINUS  &kp UNDER   &kp SQT    &kp DQT    &kp LT  
    //╰──────────┼──────────┼──────────┼──────────┼──────────┼──────────┤   ├──────────┼──────────┼──────────┼──────────┼──────────┼──────────╯
    //           │          │  ^       │  `       │  @       │          │   │  ;       │  :       │  =       │  ~       │  |       │
                    _         &kp CARET  &kp GRAVE   &kp AT     _             &kp SEMI  &kp COLON  &kp EQUAL  &kp TILDE   &kp PIPE  
    //           ╰──────────┴──────────┴──────────┤──────────█▀▀▀▀▀▀▀▀▀▀█   ├──────────┼──────────┼──────────┴──────────┴──────────╯
    //                                            │          ▌          ▐   │          │          │
                                                     _          _              _          _         
    //                                            ╰──────────▙▄▄▄▄▄▄▄▄▄▄▟   ╰──────────┴──────────╯
)

ZMK_BASE_LAYER(number,
    //                      ╭──────────┬──────────┬──────────┬──────────╮   ╭──────────┬──────────┬──────────┬──────────╮
    //                      │    9     │    8     │    7     │          │   │          │  $       │  £       │  %       │ 
                               &kp N9     &kp N8     &kp N7     _              _        &kp DOLLAR  &uc GBP  &kp PERCENT
    //╭──────────┬──────────┼──────────┼──────────┼──────────┼──────────┤   ├──────────┼──────────┼──────────┼──────────┼──────────┬──────────╮
    //│          │    3     │    2     │    1     │    0     │          │   │          │          │          │          │          │  =       │
         _          &kp N3     &kp N2     &kp N1     &kp N0     _              _          _          _          _          _        &kp EQUAL  
    //╰──────────┼──────────┼──────────┼──────────┼──────────┼──────────┤   ├──────────┼──────────┼──────────┼──────────┼──────────┼──────────╯
    //           │          │    6     │    5     │    4     │          │   │  /       │  +       │  -       │   *      │  ,       │
                    _          &kp N6     &kp N5     &kp N4     _            &kp SLASH   &kp PLUS  &kp MINUS  &kp ASTRK  &kp COMMA
    //           ╰──────────┴──────────┴──────────┤──────────┼──────────┼   ├──────────█▀▀▀▀▀▀▀▀▀▀█──────────┴──────────┴──────────╯
    //                                            │          │          │   │          ▌          ▐
                                                     _          _              _          _         
    //                                            ╰──────────┴──────────╯   ╰──────────▙▄▄▄▄▄▄▄▄▄▄▟
)

ZMK_BASE_LAYER(function,
    //                      ╭──────────┬──────────┬──────────┬──────────╮   ╭──────────┬──────────┬──────────┬──────────╮
    //                      │    F9    │    F8    │    F7    │   F12    │   │          │BRIGHT UP │BRIGHT DN │          │
                               &kp F9     &kp F8     &kp F7    &kp F12         _      &kp C_BRI_UP &kp C_BRI_DN _       
    //╭──────────┬──────────┼──────────┼──────────┼──────────┼──────────┤   ├──────────┼──────────┼──────────┼──────────┼──────────┬──────────╮
    //│   CAPS   │   F3     │    F2    │    F1    │   F10    │   F11    │   │  INSERT  │  VOL UP  │ VOL DOWN │  MUTE    │          │          │ 
        &kp CAPS    &kp F3     &kp F2     &kp F1    &kp F10    &kp F11        &kp INS  &kp C_VOL_UP &kp C_VOL_DN &kp C_MUTE _          _   
    //╰──────────┼──────────┼──────────┼──────────┼──────────┼──────────┤   ├──────────┼──────────┼──────────┼──────────┼──────────┼──────────╯
    //           │          │    F6    │    F5    │    F4    │          │   │          │PLAY/PAUSE│  NEXT    │ PREVIOUS │          │
                    _          &kp F6     &kp F5     &kp F4     _              _         &kp C_PP  &kp C_NEXT &kp C_PREV   _       
    //           ╰──────────┴──────────┴──────────┤──────────┼──────────┼   █▀▀▀▀▀▀▀▀▀▀█──────────┼──────────┴──────────┴──────────╯
    //                                            │          │          │   ▌          ▐          │
                                                     _          _              _          _         
    //                                            ╰──────────┴──────────╯   ▙▄▄▄▄▄▄▄▄▄▄▟──────────╯
)

ZMK_BASE_LAYER(keyboard,
    //                      ╭──────────┬──────────┬──────────┬──────────╮   ╭──────────┬──────────┬──────────┬──────────╮
    //                      │BT CLR ALL│          │          │  BT CLR  │   │          │ OUT USB  │ OUT BLE  │          │
                          &bt BT_CLR_ALL  _          _        &bt BT_CLR       _      &out OUT_USB &out OUT_BLE _       
    //╭──────────┬──────────┼──────────┼──────────┼──────────┼──────────┤   ├──────────┼──────────┼──────────┼──────────┼──────────┬──────────╮
    //│          │  BT 3    │  BT 2    │  BT 1    │  BT 0    │          │   │          │ MAC ON   │ MAC OFF  │          │          │          │   
         _   &bt BT_SEL 3  &bt BT_SEL 2 &bt BT_SEL 1 &bt BT_SEL 0  _           _         &mac_on    &mac_off    _          _          _
    //╰──────────┼──────────┼──────────┼──────────┼──────────┼──────────┤   ├──────────┼──────────┼──────────┼──────────┼──────────┼──────────╯
    //           │          │          │          │  BT 0    │          │   │          │  ALT  │  QWERTY  │          │          │
                    _          _          _       &bt BT_SEL 4  _              _   &tog_on ALT &tog_off ALT _        _      
    //           ╰──────────┴──────────┴──────────┤──────────█▀▀▀▀▀▀▀▀▀▀█   █▀▀▀▀▀▀▀▀▀▀█──────────┼──────────┴──────────┴──────────╯
    //                                            │          ▌          ▐   ▌          ▐          │ 
                                                     _          _              _          _
    //                                            ╰──────────▙▄▄▄▄▄▄▄▄▄▄▟   ▙▄▄▄▄▄▄▄▄▄▄▟──────────╯ 
)
